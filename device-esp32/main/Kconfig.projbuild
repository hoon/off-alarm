## device-esp32/main/Kconfig.projbuild
```kconfig
menu "off-alarm Configuration"

    config WIFI_SSID
        string "WiFi SSID"
        default "your_wifi_ssid"
        help
            SSID (network name) for the example to connect to.

    config WIFI_PASSWORD
        string "WiFi Password"
        default "your_wifi_password"
        help
            WiFi password (WPA or WPA2) for the example to use.

    menu "MQTT Configuration"
        config MQTT_BROKER_URI
            string "MQTT Broker URI"
            default "mqtt://your_mqtt_broker_ip"
            help
                URI of the MQTT broker to connect to.

        config MQTT_USERNAME
            string "MQTT Username"
            default "your_mqtt_username"
            help
                Username for MQTT authentication.

        config MQTT_PASSWORD
            string "MQTT Password"
            default "your_mqtt_password"
            help
                Password for MQTT authentication.
    endmenu

    menu "MQTT Topics"
        config EVENT_TOPIC
            string "Event Topic"
            default "off_alarm/event"
            help
                MQTT topic for publishing event messages.

        config COMMAND_TOPIC
            string "Command Topic"
            default "off_alarm/command"
            help
                MQTT topic for receiving command messages.
    endmenu

    menu "GPIO Configuration"
        config BUTTON1_GPIO
            int "Button 1 GPIO"
            default 35
            help
                GPIO number for Button 1.

        config BUTTON2_GPIO
            int "Button 2 GPIO"
            default 34
            help
                GPIO number for Button 2.

        config BUTTON3_GPIO
            int "Button 3 GPIO"
            default 25
            help
                GPIO number for Button 3.

        config BUTTON4_GPIO
            int "Button 4 GPIO"
            default 26
            help
                GPIO number for Button 4.

        config BUZZER_GPIO
            int "Buzzer GPIO"
            default 32
            help
                GPIO number for the buzzer.
    endmenu

endmenu
```
